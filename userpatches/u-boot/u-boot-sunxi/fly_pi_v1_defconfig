## userpatches/u-boot/u-boot-sunxi/fly_pi_v1_defconfig
```kconfig
CONFIG_ARM=y
CONFIG_ARCH_SUNXI=y
CONFIG_MACH_SUN50I=y
CONFIG_DEFAULT_DEVICE_TREE="sun50i-h5-fly-pi"
CONFIG_SYS_CLK_FREQ=816000000
```
